## sdkconfig.defaults
```kconfig
# Tesla BLE 仪表 - Waveshare ESP32-S3-Touch-LCD-3.49-V2

# ===== Target =====
CONFIG_IDF_TARGET="esp32s3"

# ===== Flash =====
CONFIG_ESPTOOLPY_FLASHSIZE_16MB=y
CONFIG_ESPTOOLPY_FLASHMODE_QIO=y
CONFIG_ESPTOOLPY_FLASHFREQ_80M=y
CONFIG_PARTITION_TABLE_CUSTOM=y
CONFIG_PARTITION_TABLE_CUSTOM_FILENAME="partitions.csv"

# ===== CPU / PSRAM（N16R8：8MB OCT PSRAM）=====
CONFIG_ESP_DEFAULT_CPU_FREQ_MHZ_240=y
CONFIG_SPIRAM=y
CONFIG_SPIRAM_MODE_OCT=y
CONFIG_SPIRAM_SPEED_80M=y
CONFIG_SPIRAM_MALLOC_ALWAYSINTERNAL=4096
CONFIG_SPIRAM_TRY_ALLOCATE_WIFI_LWIP=y
# PSRAM 检测失败时不要 panic 重启（此时帧缓存会降级到内部 RAM）
CONFIG_SPIRAM_IGNORE_NOTFOUND=y

# ===== Bluetooth (NimBLE, 仅 Central) =====
CONFIG_BT_ENABLED=y
CONFIG_BT_NIMBLE_ENABLED=y
CONFIG_BT_NIMBLE_ROLE_CENTRAL=y
CONFIG_BT_NIMBLE_ROLE_PERIPHERAL=n
CONFIG_BT_NIMBLE_ROLE_BROADCASTER=n
CONFIG_BT_NIMBLE_ROLE_OBSERVER=y
CONFIG_BT_NIMBLE_MAX_CONNECTIONS=1
CONFIG_BT_NIMBLE_MAX_BONDS=1
CONFIG_BT_NIMBLE_NVS_PERSIST=y
CONFIG_BT_NIMBLE_GAP_SERVICE=y
CONFIG_BT_NIMBLE_GAP_DEVICE_NAME_MAX_LEN=32
CONFIG_BT_NIMBLE_ATT_PREFERRED_MTU=512

# ===== WiFi SoftAP（配网门户）=====
CONFIG_ESP_WIFI_SOFTAP_SUPPORT=y
CONFIG_ESP_COEX_SW_COEXIST_ENABLE=y
CONFIG_LWIP_MAX_SOCKETS=10
CONFIG_HTTPD_MAX_REQ_HDR_LEN=1024
CONFIG_HTTPD_MAX_URI_LEN=512

# ===== mbedTLS =====
CONFIG_MBEDTLS_HARDWARE_AES=y
CONFIG_MBEDTLS_HARDWARE_SHA=y
CONFIG_MBEDTLS_ECP_DP_SECP256R1_ENABLED=y
CONFIG_MBEDTLS_ECDH_C=y
CONFIG_MBEDTLS_ECDSA_C=y
CONFIG_MBEDTLS_GCM_C=y
CONFIG_MBEDTLS_SHA1_C=y
CONFIG_MBEDTLS_EXTERNAL_MEM_ALLOC=y

# ===== FreeRTOS / 系统 =====
CONFIG_FREERTOS_HZ=1000
CONFIG_ESP_MAIN_TASK_STACK_SIZE=6144
CONFIG_ESP_SYSTEM_EVENT_TASK_STACK_SIZE=4096

# ===== 日志 =====
CONFIG_LOG_DEFAULT_LEVEL_INFO=y
CONFIG_LOG_MAXIMUM_LEVEL_DEBUG=y
```
